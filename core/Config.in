## core/Config.in
```kconfig
source "$BR2_EXTERNAL_MELKOR_PATH/package/dinit/Config.in"
source "$BR2_EXTERNAL_MELKOR_PATH/package/dnsproxy/Config.in"
source "$BR2_EXTERNAL_MELKOR_PATH/package/melkor-dhcpcd/Config.in"
source "$BR2_EXTERNAL_MELKOR_PATH/package/melkor-storage/Config.in"
source "$BR2_EXTERNAL_MELKOR_PATH/package/melkor-installer/Config.in"

config BR2_MELKOR_LIVE_BUILTIN_FIRMWARE
	bool "Embed firmware for the Intel AX200 in the Live kernel"
	depends on BR2_LINUX_KERNEL
	depends on BR2_PACKAGE_LINUX_FIRMWARE_IWLWIFI_22260
	depends on BR2_PACKAGE_WIRELESS_REGDB
	help
	  Use the verified firmware packages to make the AX200 firmware
	  and the signed regulatory database available for early probing.
```

## core/configs/melkor_installer_defconfig
```kconfig
BR2_x86_64=y
BR2_TOOLCHAIN_BUILDROOT_MUSL=y
BR2_TOOLCHAIN_BUILDROOT_CXX=y
BR2_GCC_VERSION_14_X=y
BR2_KERNEL_HEADERS_AS_KERNEL=y
BR2_REPRODUCIBLE=y
BR2_DOWNLOAD_FORCE_CHECK_HASHES=y

BR2_TARGET_GENERIC_HOSTNAME="melkor"
BR2_TARGET_GENERIC_ISSUE="Instalador do Melkor"
BR2_INIT_NONE=y
BR2_ROOTFS_DEVICE_CREATION_DYNAMIC_EUDEV=y
# BR2_TARGET_ENABLE_ROOT_LOGIN is not set
BR2_ROOTFS_OVERLAY="$(BR2_EXTERNAL_MELKOR_PATH)/board/m0/rootfs-overlay $(BR2_EXTERNAL_MELKOR_PATH)/board/live/rootfs-overlay $(BR2_EXTERNAL_MELKOR_PATH)/board/installer/rootfs-overlay"

BR2_LINUX_KERNEL=y
BR2_LINUX_KERNEL_LATEST_VERSION=y
BR2_LINUX_KERNEL_USE_CUSTOM_CONFIG=y
BR2_LINUX_KERNEL_CUSTOM_CONFIG_FILE="board/qemu/x86_64/linux.config"
BR2_LINUX_KERNEL_CONFIG_FRAGMENT_FILES="$(BR2_EXTERNAL_MELKOR_PATH)/board/m0/linux.fragment $(BR2_EXTERNAL_MELKOR_PATH)/board/live/linux.fragment $(BR2_EXTERNAL_MELKOR_PATH)/board/m1/linux.fragment $(BR2_EXTERNAL_MELKOR_PATH)/board/pc/linux.fragment"
BR2_LINUX_KERNEL_NEEDS_HOST_OPENSSL=y
BR2_LINUX_KERNEL_NEEDS_HOST_LIBELF=y

BR2_PACKAGE_BUSYBOX=y
BR2_PACKAGE_BUSYBOX_CONFIG_FRAGMENT_FILES="$(BR2_EXTERNAL_MELKOR_PATH)/board/m0/busybox.fragment $(BR2_EXTERNAL_MELKOR_PATH)/board/m1/busybox.fragment"
BR2_PACKAGE_DINIT=y
BR2_PACKAGE_MELKOR_INSTALLER=y
BR2_PACKAGE_UTIL_LINUX=y
BR2_PACKAGE_UTIL_LINUX_BINARIES=y
BR2_PACKAGE_UTIL_LINUX_LOSETUP=y
BR2_PACKAGE_E2FSPROGS=y
BR2_PACKAGE_DOSFSTOOLS=y
BR2_PACKAGE_DOSFSTOOLS_MKFS_FAT=y
BR2_PACKAGE_MTOOLS=y
BR2_PACKAGE_SQUASHFS=y
BR2_PACKAGE_LINUX_FIRMWARE=y
BR2_PACKAGE_LINUX_FIRMWARE_IWLWIFI_22260=y
BR2_PACKAGE_WIRELESS_REGDB=y
BR2_MELKOR_LIVE_BUILTIN_FIRMWARE=y

BR2_PACKAGE_HOST_MELKOR_LIMINE=y
BR2_TARGET_ROOTFS_CPIO=y
BR2_TARGET_ROOTFS_CPIO_GZIP=y
# BR2_TARGET_ROOTFS_TAR is not set
BR2_PACKAGE_HOST_DOSFSTOOLS=y
BR2_PACKAGE_HOST_MTOOLS=y
BR2_PACKAGE_HOST_XORRISO=y
```

## core/configs/melkor_live_defconfig
```kconfig
BR2_x86_64=y
BR2_TOOLCHAIN_BUILDROOT_MUSL=y
BR2_TOOLCHAIN_BUILDROOT_CXX=y
BR2_GCC_VERSION_14_X=y
BR2_KERNEL_HEADERS_AS_KERNEL=y
BR2_REPRODUCIBLE=y
BR2_DOWNLOAD_FORCE_CHECK_HASHES=y

BR2_TARGET_GENERIC_HOSTNAME="melkor"
BR2_TARGET_GENERIC_ISSUE="Melkor Linux Live"
BR2_INIT_NONE=y
BR2_ROOTFS_DEVICE_CREATION_DYNAMIC_DEVTMPFS=y
# BR2_TARGET_ENABLE_ROOT_LOGIN is not set
BR2_ROOTFS_USERS_TABLES="$(BR2_EXTERNAL_MELKOR_PATH)/board/live/users.txt"
BR2_ROOTFS_OVERLAY="$(BR2_EXTERNAL_MELKOR_PATH)/board/m0/rootfs-overlay $(BR2_EXTERNAL_MELKOR_PATH)/board/network/rootfs-overlay $(BR2_EXTERNAL_MELKOR_PATH)/board/live/rootfs-overlay"
BR2_ROOTFS_POST_IMAGE_SCRIPT="$(BR2_EXTERNAL_MELKOR_PATH)/board/live/post-image.sh"

BR2_LINUX_KERNEL=y
BR2_LINUX_KERNEL_LATEST_VERSION=y
BR2_LINUX_KERNEL_USE_CUSTOM_CONFIG=y
BR2_LINUX_KERNEL_CUSTOM_CONFIG_FILE="board/qemu/x86_64/linux.config"
BR2_LINUX_KERNEL_CONFIG_FRAGMENT_FILES="$(BR2_EXTERNAL_MELKOR_PATH)/board/m0/linux.fragment $(BR2_EXTERNAL_MELKOR_PATH)/board/live/linux.fragment"
BR2_LINUX_KERNEL_NEEDS_HOST_OPENSSL=y
BR2_LINUX_KERNEL_NEEDS_HOST_LIBELF=y

BR2_PACKAGE_BUSYBOX=y
BR2_PACKAGE_BUSYBOX_CONFIG_FRAGMENT_FILES="$(BR2_EXTERNAL_MELKOR_PATH)/board/m0/busybox.fragment"
BR2_PACKAGE_DINIT=y
BR2_PACKAGE_DNSPROXY=y
BR2_PACKAGE_MELKOR_DHCPCD=y
BR2_PACKAGE_UTIL_LINUX=y
BR2_PACKAGE_UTIL_LINUX_SETPRIV=y
BR2_PACKAGE_IWD=y
BR2_PACKAGE_READLINE=y
BR2_PACKAGE_IW=y
BR2_PACKAGE_LINUX_FIRMWARE=y
BR2_PACKAGE_LINUX_FIRMWARE_IWLWIFI_22260=y
BR2_PACKAGE_LINUX_FIRMWARE_RTL_RTW88=y
BR2_PACKAGE_WIRELESS_REGDB=y
BR2_MELKOR_LIVE_BUILTIN_FIRMWARE=y
BR2_PACKAGE_HOST_MELKOR_LIMINE=y
BR2_TARGET_ROOTFS_CPIO=y
BR2_TARGET_ROOTFS_CPIO_GZIP=y
# BR2_TARGET_ROOTFS_TAR is not set
BR2_PACKAGE_HOST_GENIMAGE=y
BR2_PACKAGE_HOST_DOSFSTOOLS=y
BR2_PACKAGE_HOST_MTOOLS=y
BR2_PACKAGE_HOST_XORRISO=y
```

## core/configs/melkor_pc_defconfig
```kconfig
BR2_x86_64=y
BR2_TOOLCHAIN_BUILDROOT_MUSL=y
BR2_TOOLCHAIN_BUILDROOT_CXX=y
BR2_GCC_VERSION_14_X=y
BR2_KERNEL_HEADERS_AS_KERNEL=y
BR2_REPRODUCIBLE=y
BR2_DOWNLOAD_FORCE_CHECK_HASHES=y

BR2_TARGET_GENERIC_HOSTNAME="melkor"
BR2_TARGET_GENERIC_ISSUE="Melkor Linux PC"
BR2_INIT_NONE=y
BR2_ROOTFS_DEVICE_CREATION_DYNAMIC_EUDEV=y
# BR2_TARGET_ENABLE_ROOT_LOGIN is not set
BR2_ROOTFS_USERS_TABLES="$(BR2_EXTERNAL_MELKOR_PATH)/board/pc/users.txt"
BR2_ROOTFS_OVERLAY="$(BR2_EXTERNAL_MELKOR_PATH)/board/m0/rootfs-overlay $(BR2_EXTERNAL_MELKOR_PATH)/board/network/rootfs-overlay $(BR2_EXTERNAL_MELKOR_PATH)/board/m1/rootfs-overlay $(BR2_EXTERNAL_MELKOR_PATH)/board/live/rootfs-overlay $(BR2_EXTERNAL_MELKOR_PATH)/board/pc/rootfs-overlay"
BR2_ROOTFS_POST_BUILD_SCRIPT="$(BR2_EXTERNAL_MELKOR_PATH)/board/m1/post-build.sh $(BR2_EXTERNAL_MELKOR_PATH)/board/pc/post-build.sh"

BR2_LINUX_KERNEL=y
BR2_LINUX_KERNEL_LATEST_VERSION=y
BR2_LINUX_KERNEL_USE_CUSTOM_CONFIG=y
BR2_LINUX_KERNEL_CUSTOM_CONFIG_FILE="board/qemu/x86_64/linux.config"
BR2_LINUX_KERNEL_CONFIG_FRAGMENT_FILES="$(BR2_EXTERNAL_MELKOR_PATH)/board/m0/linux.fragment $(BR2_EXTERNAL_MELKOR_PATH)/board/live/linux.fragment $(BR2_EXTERNAL_MELKOR_PATH)/board/m1/linux.fragment $(BR2_EXTERNAL_MELKOR_PATH)/board/pc/linux.fragment"
BR2_LINUX_KERNEL_NEEDS_HOST_OPENSSL=y
BR2_LINUX_KERNEL_NEEDS_HOST_LIBELF=y

BR2_PACKAGE_BUSYBOX=y
BR2_PACKAGE_BUSYBOX_CONFIG_FRAGMENT_FILES="$(BR2_EXTERNAL_MELKOR_PATH)/board/m0/busybox.fragment $(BR2_EXTERNAL_MELKOR_PATH)/board/m1/busybox.fragment"
BR2_PACKAGE_DINIT=y
BR2_PACKAGE_DNSPROXY=y
BR2_PACKAGE_MELKOR_DHCPCD=y
BR2_PACKAGE_MELKOR_STORAGE=y
BR2_PACKAGE_RAUC=y
BR2_PACKAGE_UTIL_LINUX=y
BR2_PACKAGE_UTIL_LINUX_BINARIES=y
BR2_PACKAGE_UTIL_LINUX_SETPRIV=y
BR2_PACKAGE_IWD=y
BR2_PACKAGE_READLINE=y
BR2_PACKAGE_IW=y
BR2_PACKAGE_LINUX_FIRMWARE=y
BR2_PACKAGE_LINUX_FIRMWARE_AMDGPU=y
BR2_PACKAGE_LINUX_FIRMWARE_IWLWIFI_22260=y
BR2_PACKAGE_LINUX_FIRMWARE_RTL_RTW88=y
BR2_PACKAGE_KMOD=y
BR2_PACKAGE_WIRELESS_REGDB=y
BR2_MELKOR_LIVE_BUILTIN_FIRMWARE=y

BR2_PACKAGE_SEATD=y
BR2_PACKAGE_SEATD_DAEMON=y
BR2_PACKAGE_WESTON=y
BR2_PACKAGE_WESTON_DEFAULT_DRM=y
BR2_PACKAGE_FOOT=y
BR2_PACKAGE_DEJAVU=y

BR2_TARGET_GRUB2=y
BR2_TARGET_GRUB2_X86_64_EFI=y
BR2_TARGET_GRUB2_BUILTIN_MODULES_EFI="boot linux fat part_gpt normal serial terminal regexp squash4 loadenv test"
BR2_TARGET_GRUB2_INSTALL_TOOLS=y
BR2_TARGET_ROOTFS_SQUASHFS=y
BR2_TARGET_ROOTFS_SQUASHFS4_GZIP=y
# BR2_TARGET_ROOTFS_TAR is not set
BR2_PACKAGE_HOST_DOSFSTOOLS=y
BR2_PACKAGE_HOST_MTOOLS=y
BR2_PACKAGE_HOST_RAUC=y
```

## core/package/dinit/Config.in
```kconfig
config BR2_PACKAGE_DINIT
	bool "dinit"
	depends on BR2_INSTALL_LIBSTDCPP
	depends on BR2_USE_MMU
	help
	  Service supervisor and system init written in C++.

	  https://davmac.org/projects/dinit/
```

## core/package/dnsproxy/Config.in
```kconfig
config BR2_PACKAGE_DNSPROXY
	bool "dnsproxy"
	depends on BR2_PACKAGE_HOST_GO_TARGET_ARCH_SUPPORTS
	depends on BR2_PACKAGE_HOST_GO_HOST_ARCH_SUPPORTS
	select BR2_PACKAGE_CA_CERTIFICATES
	help
	  Forward DNS queries from loopback using Quad9 over HTTPS.

	  https://github.com/AdguardTeam/dnsproxy
```

## core/package/melkor-boot/Config.in
```kconfig
config BR2_PACKAGE_MELKOR_BOOT
	bool "melkor-boot"
	depends on BR2_PACKAGE_HOST_GO_TARGET_ARCH_SUPPORTS
```

## core/package/melkor-dhcpcd/Config.in
```kconfig
config BR2_PACKAGE_MELKOR_DHCPCD
	bool "dhcpcd para o core Melkor"
	depends on BR2_USE_MMU
	depends on !BR2_PACKAGE_DHCPCD
	help
	  DHCP and IPv6 Router Advertisement client with leases in /run.

	  https://github.com/NetworkConfiguration/dhcpcd
```

## core/package/melkor-installer/Config.in
```kconfig
config BR2_PACKAGE_MELKOR_INSTALLER
	bool "melkor-installer"
	depends on BR2_PACKAGE_HOST_GO_TARGET_ARCH_SUPPORTS
	help
	  Whole-disk installer for the dedicated Melkor boot image.
```

## core/package/melkor-nushell/Config.in
```kconfig
config BR2_PACKAGE_MELKOR_NUSHELL
	bool "Nushell (upstream static binary)"
	depends on BR2_x86_64
	depends on BR2_TOOLCHAIN_USES_MUSL
	help
	  Interactive Nushell for the PC desktop. The POSIX shell
	  remains available for system scripts and recovery.
```

## core/package/melkor-storage/Config.in
```kconfig
config BR2_PACKAGE_MELKOR_STORAGE
	bool "melkor-storage"
	depends on BR2_PACKAGE_HOST_GO_TARGET_ARCH_SUPPORTS
	help
	  Resolve the other partitions from the disk that booted Melkor.
```
